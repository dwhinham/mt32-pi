## Config.in
```kconfig
source "$BR2_EXTERNAL_MT32_PI_PATH/package/libmt32emu/Config.in"
source "$BR2_EXTERNAL_MT32_PI_PATH/package/mt32d/Config.in"
```

## configs/raspberrypi2_defconfig
```kconfig
BR2_arm=y
BR2_cortex_a7=y
BR2_ARM_FPU_NEON_VFPV4=y
BR2_CCACHE=y
BR2_OPTIMIZE_3=y
BR2_TOOLCHAIN_BUILDROOT_GLIBC=y
BR2_PACKAGE_HOST_LINUX_HEADERS_CUSTOM_4_4=y
BR2_EXTRA_GCC_CONFIG_OPTIONS="--with-float=hard"
BR2_TOOLCHAIN_BUILDROOT_CXX=y
BR2_TARGET_OPTIMIZATION="-pipe -mfpu=vfpv4"
BR2_TARGET_GENERIC_HOSTNAME="mt32-pi"
BR2_TARGET_GENERIC_ISSUE="Welcome to MT-32 Pi!"
BR2_GENERATE_LOCALE="en_US"
BR2_ROOTFS_USERS_TABLES="${BR2_EXTERNAL_MT32_PI_PATH}/board/raspberrypi2/users.txt"
BR2_ROOTFS_OVERLAY="${BR2_EXTERNAL_MT32_PI_PATH}/fsoverlay"
BR2_ROOTFS_POST_BUILD_SCRIPT="${BR2_EXTERNAL_MT32_PI_PATH}/board/raspberrypi2/post-build.sh"
BR2_ROOTFS_POST_IMAGE_SCRIPT="${BR2_EXTERNAL_MT32_PI_PATH}/board/raspberrypi2/post-image.sh"
BR2_LINUX_KERNEL=y
BR2_LINUX_KERNEL_CUSTOM_GIT=y
BR2_LINUX_KERNEL_CUSTOM_REPO_URL="https://github.com/raspberrypi/linux.git"
BR2_LINUX_KERNEL_CUSTOM_REPO_VERSION="raspberrypi-kernel_1.20161020-1"
BR2_LINUX_KERNEL_PATCH="${BR2_EXTERNAL_MT32_PI_PATH}/board/raspberrypi2/patches/"
BR2_LINUX_KERNEL_USE_CUSTOM_CONFIG=y
BR2_LINUX_KERNEL_CUSTOM_CONFIG_FILE="${BR2_EXTERNAL_MT32_PI_PATH}/board/raspberrypi2/kernel.config"
BR2_LINUX_KERNEL_DTS_SUPPORT=y
BR2_LINUX_KERNEL_INTREE_DTS_NAME="bcm2709-rpi-2-b"
BR2_PACKAGE_ALSA_UTILS=y
BR2_PACKAGE_ALSA_UTILS_ALSACONF=y
BR2_PACKAGE_ALSA_UTILS_ACONNECT=y
BR2_PACKAGE_ALSA_UTILS_AMIDI=y
BR2_PACKAGE_ALSA_UTILS_AMIXER=y
BR2_PACKAGE_ALSA_UTILS_APLAY=y
BR2_PACKAGE_ALSA_UTILS_APLAYMIDI=y
BR2_PACKAGE_ALSA_UTILS_ASEQDUMP=y
BR2_PACKAGE_ALSA_UTILS_SPEAKER_TEST=y
BR2_PACKAGE_RPI_FIRMWARE=y
# BR2_PACKAGE_RPI_FIRMWARE_INSTALL_DTB_OVERLAYS is not set
BR2_PACKAGE_OPENSSH=y
BR2_TARGET_ROOTFS_EXT2=y
BR2_TARGET_ROOTFS_EXT2_4=y
# BR2_TARGET_ROOTFS_TAR is not set
BR2_PACKAGE_HOST_DOSFSTOOLS=y
BR2_PACKAGE_HOST_GENIMAGE=y
BR2_PACKAGE_HOST_MTOOLS=y
BR2_PACKAGE_LIBMT32EMU=y
BR2_PACKAGE_MT32D=y
```

## package/libmt32emu/Config.in
```kconfig
config BR2_PACKAGE_LIBMT32EMU
	bool "libmt32emu"
	help
	  C/C++ library to emulate (approximately) the Roland MT-32, CM-32L and LAPC-I synthesiser modules.

	  http://github.com/munt/munt
```

## package/mt32d/Config.in
```kconfig
config BR2_PACKAGE_MT32D
	bool "mt32d"
	depends on BR2_PACKAGE_LIBMT32EMU
	help
	  Daemon to emulate a Roland MT-32 synthesizer module.

	  http://github.com/munt/munt
```
